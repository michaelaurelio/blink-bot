#include <BLEDevice.h>
#include <BLEServer.h>
#include <BLEUtils.h>
#include <BLE2902.h>
#include <Wire.h>
#include <Adafruit_GFX.h>
#include <Adafruit_SSD1306.h>
#include <SPIFFS.h>
#include <Preferences.h>

Preferences preferences;

// BLE UUIDs - You can generate your own here: https://www.uuidgenerator.net/
#define SERVICE_UUID "4fafc201-1fb5-459e-8fcc-c5c9c331914b"
#define APP_STATE_CHARACTERISTIC_UUID "beb5483e-36e1-4688-b7f5-ea07361b26a8"
#define FACE_CONTROL_CHARACTERISTIC_UUID "a1e50300-558c-4959-819a-473a90355577"
#define CUSTOM_FACE_SELECT_CHARACTERISTIC_UUID "f2d5a225-444a-4559-8a7c-1b49c5c9c331"
#define CUSTOM_FACE_DATA_CHARACTERISTIC_UUID "a3e50300-558c-4959-819a-473a90355577"
#define FOCUS_MODE_CHARACTERISTIC_UUID "b7f6f0d3-9c2a-4f3c-8042-6f9a7e2c9b1d"

// Custom Face Storage
File customFaceFile;
String customFaceToWrite = "";
bool customFaceAvailable = false;

// Buffers for custom faces in RAM
unsigned char* custom_idle_buffer = nullptr;
unsigned char* custom_happy_buffer = nullptr;
unsigned char* custom_sad_buffer = nullptr;
unsigned char* custom_angry_buffer = nullptr;
unsigned char* custom_blink1_buffer = nullptr;
unsigned char* custom_blink2_buffer = nullptr;

// Face Bitmaps
const unsigned char epd_bitmap_face_default_blink1[] PROGMEM = {
        0x00, 0x00, 0x00, 0x00, 0x00, 0x00, 0x00, 0x00, 0x00, 0x00, 0x00, 0x00, 0x00, 0x00, 0x00, 0x00, 
    0x00, 0x00, 0x00, 0x00, 0x00, 0x00, 0x00, 0x00, 0x00, 0x00, 0x00, 0x00, 0x00, 0x00, 0x00, 0x00, 
    0x00, 0x00, 0x00, 0x00, 0x00, 0x00, 0x00, 0x00, 0x00, 0x00, 0x00, 0x00, 0x00, 0x00, 0x00, 0x00, 
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    0x00, 0x00, 0x00, 0x00, 0x00, 0x00, 0x00, 0x00, 0x00, 0x00, 0x00, 0x00, 0x00, 0x00, 0x00, 0x00
};

const unsigned char epd_bitmap_face_default_blink2[] PROGMEM = {
    0x00, 0x00, 0x00, 0x00, 0x00, 0x00, 0x00, 0x00, 0x00, 0x00, 0x00, 0x00, 0x00, 0x00, 0x00, 0x00, 
    0x00, 0x00, 0x00, 0x00, 0x00, 0x00, 0x00, 0x00, 0x00, 0x00, 0x00, 0x00, 0x00, 0x00, 0x00, 0x00, 
    0x00, 0x00, 0x00, 0x00, 0x00, 0x00, 0x00, 0x00, 0x00, 0x00, 0x00, 0x00, 0x00, 0x00, 0x00, 0x00, 
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    0x00, 0x00, 0x00, 0x00, 0x00, 0x00, 0x00, 0x00, 0x00, 0x00, 0x00, 0x00, 0x00, 0x00, 0x00, 0x00
};

 const unsigned char epd_bitmap_face_default_idle[] PROGMEM = {
    0x00, 0x00, 0x00, 0x00, 0x00, 0x00, 0x00, 0x00, 0x00, 0x00, 0x00, 0x00, 0x00, 0x00, 0x00, 0x00, 
    0x00, 0x00, 0x00, 0x00, 0x00, 0x00, 0x00, 0x00, 0x00, 0x00, 0x00, 0x00, 0x00, 0x00, 0x00, 0x00, 
    0x00, 0x00, 0x00, 0x00, 0x00, 0x00, 0x00, 0x00, 0x00, 0x00, 0x00, 0x00, 0x00, 0x00, 0x00, 0x00, 
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    0x00, 0x00, 0x00, 0x00, 0x00, 0x00, 0x00, 0x00, 0x00, 0x00, 0x00, 0x00, 0x00, 0x00, 0x00, 0x00
};

const unsigned char epd_bitmap_face_default_happy[] PROGMEM = {
        0x00, 0x00, 0x00, 0x00, 0x00, 0x00, 0x00, 0x00, 0x00, 0x00, 0x00, 0x00, 0x00, 0x00, 0x00, 0x00, 
    0x00, 0x00, 0x00, 0x00, 0x00, 0x00, 0x00, 0x00, 0x00, 0x00, 0x00, 0x00, 0x00, 0x00, 0x00, 0x00, 
    0x00, 0x00, 0x00, 0x00, 0x00, 0x00, 0x00, 0x00, 0x00, 0x00, 0x00, 0x00, 0x00, 0x00, 0x00, 0x00, 
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    0x00, 0x00, 0x00, 0x00, 0x00, 0x00, 0x00, 0x00, 0x00, 0x00, 0x00, 0x00, 0x00, 0x00, 0x00, 0x00
};

// 'face-angry', 128x64px
const unsigned char epd_bitmap_face_default_angry[] PROGMEM = {
	0x00, 0x00, 0x00, 0x00, 0x00, 0x00, 0x00, 0x00, 0x00, 0x00, 0x00, 0x00, 0x00, 0x00, 0x00, 0x00, 
	0x00, 0x00, 0x00, 0x00, 0x00, 0x00, 0x00, 0x00, 0x00, 0x00, 0x00, 0x00, 0x00, 0x00, 0x00, 0x00, 
	0x00, 0x00, 0x00, 0x00, 0x00, 0x00, 0x00, 0x00, 0x00, 0x00, 0x00, 0x00, 0x00, 0x00, 0x00, 0x00, 
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	0x00, 0x00, 0x00, 0x00, 0x00, 0x00, 0x00, 0x00, 0x00, 0x00, 0x00, 0x00, 0x00, 0x00, 0x00, 0x00
};


// Display & Hardware
#define SCREEN_WIDTH 128
#define SCREEN_HEIGHT 64
#define OLED_RESET -1
Adafruit_SSD1306 display(SCREEN_WIDTH, SCREEN_HEIGHT, &Wire, OLED_RESET);
const int buttonPins[6] = {0, 1, 2, 3, 5, 6};
int buttonStates[6];
int lastButtonStates[6];
#define BUZZER_PIN 21
#define NOTE_A4 440
#define NOTE_C5 523
#define NOTE_F5 698

// BLE State
bool deviceConnected = false;
bool bluetoothEnabled = true;

// Menu and states
const char *menuItems[] = {"Timer", "Stopwatch", "Pomodoro", "Settings", "Info", "Bluetooth", "Focus Mode"};
const int menuLength = 7;
int selectedItem = 0;
int currentPage = 0;
const int itemsPerPage = 4;
int totalPages = (menuLength + itemsPerPage - 1) / itemsPerPage;
bool showHome = true;
bool showMenu = false;
bool showTimer = false;
bool showStopwatch = false;
bool showPomodoro = false;
bool showSettings = false;
bool showInfo = false;
bool showBluetoothSettings = false;
bool showFocusModeSettings = false;
bool focusModeEnabled = false;
unsigned long lastInteraction = 0;
const unsigned long idleTimeout = 10000;
bool showSubMenu = false;
int subMenuIndex = 0;
int subMenuLength = 2;
const char *subMenuItems[] = {"CONTINUE", "RESET"};

// Timer variables
unsigned long _timerBegin = 0;
bool timerRunning = false;
bool timerFinished = false;
int timerMinutes = 0;
int timerSeconds = 3;
unsigned long timerTotalSeconds = timerMinutes * 60 + timerSeconds;
bool buzzerPlayedTimerFinished = false;
unsigned long timerPausedSeconds = timerTotalSeconds;
enum TimerEditField { TIMER_EDIT_MINUTE, TIMER_EDIT_SECOND };
TimerEditField timerEditField = TIMER_EDIT_MINUTE;
unsigned long lastBlinkTime = 0;
bool blinkVisible = true;
const unsigned long blinkInterval = 500;

// Stopwatch variables
unsigned long _stopwatchBegin = 0;
bool stopwatchRunning = false;
unsigned long stopwatchPausedMillis = 0;

// Pomodoro variables
enum PomodoroPhase { POMODORO_WORK, POMODORO_BREAK };
PomodoroPhase pomodoroPhase = POMODORO_WORK;
int pomodoroWorkMinutes = 1;
int pomodoroWorkSecondsConfig = 0;
int pomodoroBreakMinutes = 1;
int pomodoroBreakSecondsConfig = 0;
unsigned long pomodoroWorkSeconds = pomodoroWorkMinutes * 60 + pomodoroWorkSecondsConfig;
unsigned long pomodoroBreakSeconds = pomodoroBreakMinutes * 60 + pomodoroBreakSecondsConfig;
unsigned long pomodoroStartMillis = 0;
unsigned long pomodoroRemainingSeconds = pomodoroWorkSeconds;
bool pomodoroRunning = false;
bool pomodoroFinished = false;
bool buzzerPlayedPomodoroFinished = false;
enum PomodoroEditField { POMODORO_EDIT_MINUTE, POMODORO_EDIT_SECOND };
PomodoroEditField pomodoroEditField = POMODORO_EDIT_MINUTE;

// Buzzer variables
unsigned long buzzerStartTime = 0;
bool buzzerActive = false;
int buzzerToneType = 0;
int buzzerFinishedCount = 0;
unsigned long buzzerFinishedLastChange = 0;

// Animation variables
enum FaceAnimationState { ANIM_IDLE, ANIM_HAPPY, ANIM_SAD, ANIM_ANGRY };
FaceAnimationState currentAnimationState = ANIM_IDLE;

class FacePackage {
public:
    const unsigned char *const *idleFrames;
    const unsigned char *const *blinkFrames;
    const unsigned char *const *happyFrames;
    const unsigned char *const *sadFrames;
    const unsigned char *const *angryFrames;
    int idleFrameCount;
    int blinkFrameCount;
    int happyFrameCount;
    int sadFrameCount;
    int angryFrameCount;
};

const unsigned char *defaultIdleFrames[] = {epd_bitmap_face_default_idle};
const unsigned char *defaultBlinkFrames[] = {epd_bitmap_face_default_blink1, epd_bitmap_face_default_blink1, epd_bitmap_face_default_blink1, epd_bitmap_face_default_blink2};
const unsigned char *defaultHappyFrames[] = {epd_bitmap_face_default_happy};
const unsigned char *defaultSadFrames[] = {epd_bitmap_face_default_idle}; // Placeholder
const unsigned char *defaultAngryFrames[] = {epd_bitmap_face_default_angry}; // Placeholder

// Custom face frames (pointers to buffers)
const unsigned char *customIdleFrames[1];
const unsigned char *customBlinkFrames[2];
const unsigned char *customHappyFrames[1];
const unsigned char *customSadFrames[1];
const unsigned char *customAngryFrames[1];

FacePackage defaultFace = {
    defaultIdleFrames,
    defaultBlinkFrames,
    defaultHappyFrames,
    defaultSadFrames,
    defaultAngryFrames,
    1, // idleFrameCount
    4, // blinkFrameCount
    1, // happyFrameCount
    1, // sadFrameCount
    1  // angryFrameCount
};

FacePackage customFace = {
    customIdleFrames,
    customBlinkFrames,
    customHappyFrames,
    customSadFrames,
    customAngryFrames,
    1, // idleFrameCount
    2, // blinkFrameCount
    1, // happyFrameCount
    1, // sadFrameCount
    1  // angryFrameCount
};

FacePackage *currentFace = &defaultFace;

void loadCustomFaces() {
    if (SPIFFS.exists("/custom_idle.bin")) {
        File file = SPIFFS.open("/custom_idle.bin", "r");
        custom_idle_buffer = (unsigned char*)malloc(file.size());
        file.read(custom_idle_buffer, file.size());
        customIdleFrames[0] = custom_idle_buffer;
        file.close();
        customFaceAvailable = true;
    } else {
      return; // If idle doesn't exist, no point loading others
    }

    if (SPIFFS.exists("/custom_happy.bin")) {
        File file = SPIFFS.open("/custom_happy.bin", "r");
        custom_happy_buffer = (unsigned char*)malloc(file.size());
        file.read(custom_happy_buffer, file.size());
        customHappyFrames[0] = custom_happy_buffer;
        file.close();
    }

    if (SPIFFS.exists("/custom_sad.bin")) {
        File file = SPIFFS.open("/custom_sad.bin", "r");
        custom_sad_buffer = (unsigned char*)malloc(file.size());
        file.read(custom_sad_buffer, file.size());
        customSadFrames[0] = custom_sad_buffer;
        file.close();
    }

    if (SPIFFS.exists("/custom_angry.bin")) {
        File file = SPIFFS.open("/custom_angry.bin", "r");
        custom_angry_buffer = (unsigned char*)malloc(file.size());
        file.read(custom_angry_buffer, file.size());
        customAngryFrames[0] = custom_angry_buffer;
        file.close();
    }

    if (SPIFFS.exists("/custom_blink1.bin")) {
        File file = SPIFFS.open("/custom_blink1.bin", "r");
        custom_blink1_buffer = (unsigned char*)malloc(file.size());
        file.read(custom_blink1_buffer, file.size());
        customBlinkFrames[0] = custom_blink1_buffer;
        file.close();
    }

    if (SPIFFS.exists("/custom_blink2.bin")) {
        File file = SPIFFS.open("/custom_blink2.bin", "r");
        custom_blink2_buffer = (unsigned char*)malloc(file.size());
        file.read(custom_blink2_buffer, file.size());
        customBlinkFrames[1] = custom_blink2_buffer;
        file.close();
    }
}

unsigned long lastAnimUpdate = 0;
const unsigned long animDelay = 200;
const unsigned long animBlinkInterval = 2000;
int currentFrame = 0;
bool isBlinking = false;
unsigned long lastAnimBlinkTime = 0;

unsigned long celebrationStartTime = 0;
bool celebrationAnimationPlaying = false;
const unsigned long celebrationDuration = 3000;
int celebrationBlinkCount = 0;
unsigned long celebrationLastChange = 0;
bool celebrationShowingCelebrate = true;

// Settings variables
int settingsSelectedItem = 0;
const int settingsMenuLength = 3;
const char *settingsMenuItems[] = {"Style", "Sound", "Display"};
int currentStyle = 0; // 0 for Default, 1 for Custom

// Forward declarations for BLE
void startBluetooth();
void stopBluetooth();
void resetFaceAnimation();

// ----- BLE CALLBACKS -----

class ServerCallbacks : public BLEServerCallbacks {
    void onConnect(BLEServer *pServer) {
        deviceConnected = true;
        Serial.println("[+] Bluetooth Connected!");
    }

    void onDisconnect(BLEServer *pServer) {
        deviceConnected = false;
        Serial.println("[-] Bluetooth Disconnected!");
        // Restart advertising if Bluetooth is still enabled
        if (bluetoothEnabled) {
            pServer->getAdvertising()->start();
            Serial.println("Restarting advertising...");
        }
    }
};

class AppStateCallbacks : public BLECharacteristicCallbacks {
    void onWrite(BLECharacteristic *pCharacteristic) {
        if (!focusModeEnabled) return; // Do nothing if focus mode is off

        String value = pCharacteristic->getValue();
        Serial.print("App State Received: ");
        Serial.println(value);

        if (value == "1") {
            Serial.println("Mobile app is open.");
            currentAnimationState = ANIM_IDLE;
            // Force the display to the home screen to show the new face
            showHome = true;
            showMenu = showTimer = showStopwatch = showPomodoro = showSettings = showInfo = showBluetoothSettings = false;
            resetFaceAnimation();
        } else {
            Serial.println("Mobile app is closed.");
            currentAnimationState = ANIM_ANGRY;
            // Force the display to the home screen to show the new face
            showHome = true;
            showMenu = showTimer = showStopwatch = showPomodoro = showSettings = showInfo = showBluetoothSettings = false;
            resetFaceAnimation();
        }
    }
};

class FocusModeCallbacks : public BLECharacteristicCallbacks {
    void onWrite(BLECharacteristic *pCharacteristic) {
        String value = pCharacteristic->getValue();
        value.trim();
        value.toUpperCase();

        bool requestedState = focusModeEnabled;
        if (value == "ON" || value == "1" || value == "TRUE") {
            requestedState = true;
        } else if (value == "OFF" || value == "0" || value == "FALSE") {
            requestedState = false;
        } else {
            Serial.print("Unknown focus mode command: ");
            Serial.println(value);
            return;
        }

        if (requestedState != focusModeEnabled) {
            focusModeEnabled = requestedState;
            preferences.putBool("focusMode", focusModeEnabled);
            Serial.print("Focus Mode set via BLE: ");
            Serial.println(focusModeEnabled ? "ON" : "OFF");

            if (showFocusModeSettings) {
                drawFocusModeSettings();
            }

            if (!focusModeEnabled) {
                currentAnimationState = ANIM_IDLE;
                resetFaceAnimation();
            }
        }
    }
};

class FaceControlCallbacks : public BLECharacteristicCallbacks {
    void onWrite(BLECharacteristic *pCharacteristic) {
        String value = pCharacteristic->getValue();
        Serial.print("Face Control Received: ");
        Serial.println(value);

        bool stateChanged = false;
        if (value == "IDLE") {
            currentAnimationState = ANIM_IDLE;
            stateChanged = true;
        } else if (value == "HAPPY") {
            currentAnimationState = ANIM_HAPPY;
            stateChanged = true;
        } else if (value == "SAD") {
            currentAnimationState = ANIM_SAD;
            stateChanged = true;
        } else if (value == "ANGRY") {
            currentAnimationState = ANIM_ANGRY;
            stateChanged = true;
        }

        if (stateChanged) {
            // Force the display to the home screen to show the new face
            showHome = true;
            showMenu = showTimer = showStopwatch = showPomodoro = showSettings = showInfo = showBluetoothSettings = false;
            resetFaceAnimation();
        }
    }
};

class CustomFaceSelectCallbacks : public BLECharacteristicCallbacks {
    void onWrite(BLECharacteristic *pCharacteristic) {
        String value = pCharacteristic->getValue();
        if (value.length() > 0) {
            customFaceToWrite = value;
            String filePath = "/" + customFaceToWrite + ".bin";

            // Close any previously opened file
            if (customFaceFile) {
                customFaceFile.close();
            }

            // Open the new file for writing
            customFaceFile = SPIFFS.open(filePath, FILE_WRITE);
            if (!customFaceFile) {
                Serial.println("Failed to open file for writing");
            }
        }
    }
};

class CustomFaceDataCallbacks : public BLECharacteristicCallbacks {
    void onWrite(BLECharacteristic *pCharacteristic) {
        size_t len = pCharacteristic->getLength();
        if (customFaceFile) {
            if (len > 0) {
                customFaceFile.write(pCharacteristic->getData(), len);
            } else {
                // Zero-length payload signifies end of transfer
                customFaceFile.close();
                Serial.println("Finished writing to file");
            }
        }
    }
};

void drawBluetoothSettings() {
    display.clearDisplay();
    display.setTextSize(1);
    display.setTextColor(SSD1306_WHITE);
    display.setCursor(0, 0);
    display.println("Bluetooth Settings");

    display.setCursor(10, 25);
    display.print("Status: ");
    display.print(bluetoothEnabled ? "ON" : "OFF");

    display.setCursor(10, 45);
    display.print("Press SELECT");
    display.display();
}

void drawFocusModeSettings() {
    display.clearDisplay();
    display.setTextSize(1);
    display.setTextColor(SSD1306_WHITE);
    display.setCursor(0, 0);
    display.println("Focus Mode");

    display.setCursor(10, 25);
    display.print("Status: ");
    display.print(focusModeEnabled ? "ON" : "OFF");

    display.setCursor(10, 45);
    display.print("Press SELECT");
    display.display();
}

void stopBluetooth() {
    BLEDevice::deinit(true);
    Serial.println("Bluetooth Deinitialized");
}

void setup() {
    Serial.begin(115200);

    if(!SPIFFS.begin(true)){
        Serial.println("An Error has occurred while mounting SPIFFS");
        return;
    }

    if (!display.begin(SSD1306_SWITCHCAPVCC, 0x3C)) {
        Serial.println(F("SSD1306 allocation failed"));
        for (;;);
    }

    pinMode(BUZZER_PIN, OUTPUT);

    for (int i = 0; i < 6; i++) {
        pinMode(buttonPins[i], INPUT_PULLUP);
        lastButtonStates[i] = HIGH;
    }

    if (bluetoothEnabled) {
        startBluetooth();
    }
    loadCustomFaces();

    preferences.begin("blink-bot", false);
    currentStyle = preferences.getInt("faceStyle", 0);
    if (currentStyle == 1 && customFaceAvailable) {
        currentFace = &customFace;
    } else {
        currentStyle = 0; // Fallback to default if custom not available
        currentFace = &defaultFace;
    }
    focusModeEnabled = preferences.getBool("focusMode", false);

    drawHome();
}

void loop() {
    bool anyPressed = false;

    for (int i = 0; i < 6; i++) {
        buttonStates[i] = digitalRead(buttonPins[i]);

        if (buttonStates[i] == LOW && lastButtonStates[i] == HIGH) {
            anyPressed = true;
            lastInteraction = millis();

            if (showHome) {
                showHome = false;
                showMenu = true;
                drawMenu();
            } else if (showMenu) {
                if (i == 0) { // Up
                    selectedItem--;
                    if (selectedItem < 0) {
                        selectedItem = menuLength - 1;
                        currentPage = totalPages - 1;
                    } else if (selectedItem < currentPage * itemsPerPage) {
                        currentPage--;
                    }
                    drawMenu();
                } else if (i == 1) { // Down
                    selectedItem++;
                    if (selectedItem >= menuLength) {
                        selectedItem = 0;
                        currentPage = 0;
                    } else if (selectedItem >= (currentPage + 1) * itemsPerPage) {
                        currentPage++;
                    }
                    drawMenu();
                } else if (i == 2) { // Left (Page Up)
                    currentPage--;
                    if (currentPage < 0) currentPage = totalPages - 1;
                    selectedItem = currentPage * itemsPerPage;
                    drawMenu();
                } else if (i == 3) { // Right (Page Down)
                    currentPage++;
                    if (currentPage >= totalPages) currentPage = 0;
                    selectedItem = currentPage * itemsPerPage;
                    drawMenu();
                } else if (i == 4) { // Select
                    selectMenuItem(selectedItem);
                } else if (i == 5) { // Back
                    showMenu = false;
                    showHome = true;
                    drawHome();
                }
            } else {
                // Item Mode: Timer
                if (showTimer) {
                    // Timer configuration logic (only when timer is not running or finished)
                    if (!timerRunning && !timerFinished && !showSubMenu) {
                        if (i == 2) { // Left
                            timerEditField = TIMER_EDIT_MINUTE;
                            drawTimer();
                        } else if (i == 3) { // Right
                            timerEditField = TIMER_EDIT_SECOND;
                            drawTimer();
                        } else if (i == 0) { // Increase
                            if (timerEditField == TIMER_EDIT_MINUTE) {
                                timerMinutes = (timerMinutes + 1) % 60;
                            } else if (timerEditField == TIMER_EDIT_SECOND) {
                                timerSeconds = (timerSeconds + 1) % 60;
                            }
                            timerTotalSeconds = timerMinutes * 60 + timerSeconds;
                            timerPausedSeconds = timerTotalSeconds;
                            drawTimer();
                        } else if (i == 1) { // Decrease
                            if (timerEditField == TIMER_EDIT_MINUTE) {
                                timerMinutes = (timerMinutes == 0) ? 59 : timerMinutes - 1;
                            } else if (timerEditField == TIMER_EDIT_SECOND) {
                                timerSeconds = (timerSeconds == 0) ? 59 : timerSeconds - 1;
                            }
                            timerTotalSeconds = timerMinutes * 60 + timerSeconds;
                            timerPausedSeconds = timerTotalSeconds;
                            drawTimer();
                        }
                    }

                    if (showSubMenu) {
                        if (i == 2) {
                            subMenuIndex--;
                            if (subMenuIndex < 0) subMenuIndex = subMenuLength - 1;
                            drawTimer();
                        } else if (i == 3) {
                            subMenuIndex++;
                            if (subMenuIndex >= subMenuLength) subMenuIndex = 0;
                            drawTimer();
                        } else if (i == 4) {
                            if (subMenuIndex == 0) {
                                // Continue
                                timerRunning = true;
                                _timerBegin = millis() - (timerTotalSeconds - timerPausedSeconds) * 1000;
                                showSubMenu = false;
                                buzzerStartStop(true);
                            } else {
                                // Reset
                                timerRunning = false;
                                timerFinished = false;
                                buzzerPlayedTimerFinished = false;
                                timerPausedSeconds = timerTotalSeconds; // Reset to full time
                                showSubMenu = false;
                                drawTimer();
                                buzzerStartStop(false);
                            }
                        } else if (i == 5) {
                            timerRunning = false;
                            timerFinished = false;
                            buzzerPlayedTimerFinished = false;
                            timerPausedSeconds = timerTotalSeconds;
                            _timerBegin = 0;
                            showSubMenu = false;
                            showTimer = false;
                            showMenu = true;
                            buzzerStartStop(false);
                            drawMenu();
                        }
                    } else {
                        if (i == 4) {
                            if (timerFinished) {
                                timerRunning = false;
                                timerFinished = false;
                                buzzerPlayedTimerFinished = false;
                                timerPausedSeconds = timerTotalSeconds;
                                _timerBegin = 0;
                                drawTimer();
                                buzzerStartStop(false);
                            } else {
                                if (timerRunning) {
                                    // Pause timer
                                    timerPausedSeconds = getRemainingTimer();
                                    timerRunning = false;
                                    showSubMenu = true;
                                    subMenuIndex = 0;
                                    buzzerStartStop(false);
                                    drawTimer();
                                } else {
                                    // Start or resume
                                    if (timerPausedSeconds == 0 || timerPausedSeconds == timerTotalSeconds) {
                                        _timerBegin = millis();
                                        timerPausedSeconds = timerTotalSeconds;
                                    } else {
                                        _timerBegin = millis() - (timerTotalSeconds - timerPausedSeconds) * 1000;
                                    }
                                    timerRunning = true;
                                    timerFinished = false;
                                    buzzerStartStop(true);
                                }
                            }
                        } else if (i == 5) {
                            timerRunning = false;
                            timerFinished = false;
                            buzzerPlayedTimerFinished = false;
                            timerPausedSeconds = timerTotalSeconds;
                            showTimer = false;
                            showMenu = true;
                            drawMenu();
                        }
                    }
                }

                // Item Mode: Stopwatch
                else if (showStopwatch) {
                    if (showSubMenu) {
                        if (i == 2) {
                            subMenuIndex--;
                            if (subMenuIndex < 0) subMenuIndex = subMenuLength - 1;
                            drawStopwatch();
                        } else if (i == 3) {
                            subMenuIndex++;
                            if (subMenuIndex >= subMenuLength) subMenuIndex = 0;
                            drawStopwatch();
                        } else if (i == 4) {
                            if (subMenuIndex == 0) {
                                stopwatchRunning = true;
                                _stopwatchBegin = millis() - stopwatchPausedMillis;
                                showSubMenu = false;
                                buzzerStartStop(true);
                            } else {
                                stopwatchRunning = false;
                                _stopwatchBegin = 0;
                                stopwatchPausedMillis = 0;
                                showSubMenu = false;
                                buzzerStartStop(false);
                                drawStopwatch();
                            }
                        } else if (i == 5) {
                            stopwatchRunning = false;
                            stopwatchPausedMillis = 0;
                            _stopwatchBegin = 0;
                            showSubMenu = false;
                            showStopwatch = false;
                            showMenu = true;
                            buzzerStartStop(false);
                            drawMenu();
                        }
                    } else {
                        if (i == 4) {
                            if (stopwatchRunning) {
                                stopwatchPausedMillis = getElapsedStopwatch();
                                stopwatchRunning = false;
                                showSubMenu = true;
                                subMenuIndex = 0;
                                buzzerStartStop(false);
                                drawStopwatch();
                            } else {
                                stopwatchRunning = true;
                                _stopwatchBegin = millis() - stopwatchPausedMillis;
                                buzzerStartStop(true);
                            }
                        } else if (i == 5) {
                            stopwatchRunning = false;
                            stopwatchPausedMillis = 0;
                            showStopwatch = false;
                            showMenu = true;
                            drawMenu();
                        }
                    }
                }

                // Item Mode: Pomodoro
                else if (showPomodoro) {
                    if (!pomodoroRunning && !pomodoroFinished && !showSubMenu) {
                        if (i == 2) { // Left
                            pomodoroEditField = POMODORO_EDIT_MINUTE;
                            drawPomodoro();
                        } else if (i == 3) { // Right
                            pomodoroEditField = POMODORO_EDIT_SECOND;
                            drawPomodoro();
                        } else if (i == 0) { // Increase
                            if (pomodoroPhase == POMODORO_WORK) {
                                if (pomodoroEditField == POMODORO_EDIT_MINUTE) {
                                    pomodoroWorkMinutes = (pomodoroWorkMinutes + 1) % 60;
                                } else if (pomodoroEditField == POMODORO_EDIT_SECOND) {
                                    pomodoroWorkSecondsConfig = (pomodoroWorkSecondsConfig + 1) % 60;
                                }
                                pomodoroWorkSeconds = pomodoroWorkMinutes * 60 + pomodoroWorkSecondsConfig;
                                pomodoroRemainingSeconds = pomodoroWorkSeconds;
                            } else {
                                if (pomodoroEditField == POMODORO_EDIT_MINUTE) {
                                    pomodoroBreakMinutes = (pomodoroBreakMinutes + 1) % 60;
                                } else if (pomodoroEditField == POMODORO_EDIT_SECOND) {
                                    pomodoroBreakSecondsConfig = (pomodoroBreakSecondsConfig + 1) % 60;
                                }
                                pomodoroBreakSeconds = pomodoroBreakMinutes * 60 + pomodoroBreakSecondsConfig;
                                pomodoroRemainingSeconds = pomodoroBreakSeconds;
                            }
                            drawPomodoro();
                        } else if (i == 1) { // Decrease
                            if (pomodoroPhase == POMODORO_WORK) {
                                if (pomodoroEditField == POMODORO_EDIT_MINUTE) {
                                    pomodoroWorkMinutes = (pomodoroWorkMinutes == 0) ? 59 : pomodoroWorkMinutes - 1;
                                } else if (pomodoroEditField == POMODORO_EDIT_SECOND) {
                                    pomodoroWorkSecondsConfig = (pomodoroWorkSecondsConfig == 0) ? 59 : pomodoroWorkSecondsConfig - 1;
                                }
                                pomodoroWorkSeconds = pomodoroWorkMinutes * 60 + pomodoroWorkSecondsConfig;
                                pomodoroRemainingSeconds = pomodoroWorkSeconds;
                            } else {
                                if (pomodoroEditField == POMODORO_EDIT_MINUTE) {
                                    pomodoroBreakMinutes = (pomodoroBreakMinutes == 0) ? 59 : pomodoroBreakMinutes - 1;
                                } else if (pomodoroEditField == POMODORO_EDIT_SECOND) {
                                    pomodoroBreakSecondsConfig = (pomodoroBreakSecondsConfig == 0) ? 59 : pomodoroBreakSecondsConfig - 1;
                                }
                                pomodoroBreakSeconds = pomodoroBreakMinutes * 60 + pomodoroBreakSecondsConfig;
                                pomodoroRemainingSeconds = pomodoroBreakSeconds;
                            }
                            drawPomodoro();
                        }
                    }

                    if (showSubMenu) {
                        // Navigate submenu
                        if (i == 2) { // Left
                            subMenuIndex--;
                            if (subMenuIndex < 0) subMenuIndex = subMenuLength - 1;
                            drawPomodoro();
                        } else if (i == 3) { // Right
                            subMenuIndex++;
                            if (subMenuIndex >= subMenuLength) subMenuIndex = 0;
                            drawPomodoro();
                        } else if (i == 4) { // Select
                            if (subMenuIndex == 0) { // Continue
                                unsigned long total = (pomodoroPhase == POMODORO_WORK) ? pomodoroWorkSeconds : pomodoroBreakSeconds;
                                pomodoroStartMillis = millis() - ((total - pomodoroRemainingSeconds) * 1000);
                                pomodoroRunning = true;
                                showSubMenu = false;
                                buzzerStartStop(true);
                            } else { // Reset
                                pomodoroPhase = POMODORO_WORK;
                                pomodoroRemainingSeconds = pomodoroWorkSeconds;
                                pomodoroRunning = false;
                                pomodoroFinished = false;
                                showSubMenu = false;
                                drawPomodoro();
                            }
                        } else if (i == 5) { // Back
                            pomodoroRunning = false;
                            pomodoroFinished = false;
                            showSubMenu = false;
                            showPomodoro = false;
                            showMenu = true;
                            drawMenu();
                        }
                    } else {
                        if (i == 4) { // Start / Pause
                            if (pomodoroFinished) {
                                // Switch to next phase and reset for configuration
                                if (pomodoroPhase == POMODORO_WORK) {
                                    pomodoroPhase = POMODORO_BREAK;
                                    pomodoroRemainingSeconds = pomodoroBreakSeconds;
                                } else {
                                    pomodoroPhase = POMODORO_WORK;
                                    pomodoroRemainingSeconds = pomodoroWorkSeconds;
                                }

                                // Reset celebration and finished states
                                pomodoroFinished = false;
                                celebrationAnimationPlaying = false;

                                // Reset edit field and blink state for configuration
                                pomodoroEditField = POMODORO_EDIT_MINUTE;
                                blinkVisible = true;
                                lastBlinkTime = millis();

                                drawPomodoro();
                            } else if (pomodoroRunning) {
                                pomodoroRemainingSeconds = getRemainingPomodoro();
                                pomodoroRunning = false;
                                showSubMenu = true;
                                subMenuIndex = 0;
                                buzzerStartStop(false);
                                drawPomodoro();
                            } else {
                                unsigned long total = (pomodoroPhase == POMODORO_WORK) ? pomodoroWorkSeconds : pomodoroBreakSeconds;
                                pomodoroStartMillis = millis() - ((total - pomodoroRemainingSeconds) * 1000);
                                pomodoroRunning = true;
                                pomodoroFinished = false;
                                buzzerStartStop(true);
                                drawPomodoro();
                            }
                        } else if (i == 5) { // Back
                            pomodoroRunning = false;
                            pomodoroFinished = false;
                            celebrationAnimationPlaying = false;
                            showPomodoro = false;
                            showMenu = true;
                            drawMenu();
                        }
                    }
                }

                // Item Mode: Settings
                else if (showSettings) {
                    if (i == 0) { // Up
                        settingsSelectedItem--;
                        if (settingsSelectedItem < 0) settingsSelectedItem = settingsMenuLength - 1;
                        drawSettings();
                    } else if (i == 1) { // Down
                        settingsSelectedItem++;
                        if (settingsSelectedItem >= settingsMenuLength) settingsSelectedItem = 0;
                        drawSettings();
                    } else if (i == 4) { // Select
                        if (settingsSelectedItem == 0) { // Style
                            currentStyle = 1 - currentStyle; // Toggle 0 and 1
                            if (currentStyle == 1 && customFaceAvailable) {
                                currentFace = &customFace;
                            } else {
                                currentStyle = 0; // Fallback to default
                                currentFace = &defaultFace;
                            }
                            preferences.putInt("faceStyle", currentStyle);
                            drawSettings();
                        }
                    } else if (i == 5) { // Back
                        showSettings = false;
                        showMenu = true;
                        drawMenu();
                    }
                }

                // Item Mode: Info
                else if (showInfo) {
                    if (i == 5) {
                        showInfo = false;
                        showMenu = true;
                        drawMenu();
                    }
                }

                // Item Mode: Bluetooth Settings
                else if (showBluetoothSettings) {
                    if (i == 4) { // Select
                        bluetoothEnabled = !bluetoothEnabled;
                        if (bluetoothEnabled) {
                            startBluetooth();
                        } else {
                            stopBluetooth();
                        }
                        drawBluetoothSettings();
                    } else if (i == 5) { // Back
                        showBluetoothSettings = false;
                        showMenu = true;
                        drawMenu();
                    }
                }

                // Item Mode: Focus Mode Settings
                else if (showFocusModeSettings) {
                    if (i == 4) { // Select
                        focusModeEnabled = !focusModeEnabled;
                        preferences.putBool("focusMode", focusModeEnabled);
                        drawFocusModeSettings();
                    } else if (i == 5) { // Back
                        showFocusModeSettings = false;
                        showMenu = true;
                        drawMenu();
                    }
                }
            }
        }
        lastButtonStates[i] = buttonStates[i];
    }

    if ((showMenu) && (millis() - lastInteraction > idleTimeout)) {
        showMenu = false;
        showHome = true;
        selectedItem = 0;
        currentPage = 0;
        drawHome();
    }

    updateTimer();
    updateStopwatch();
    updatePomodoro();
    updateHomeAnimation();
    updateBuzzer();

    display.display();

    delay(10);
}

void selectMenuItem(int index) {
    showMenu = false;

    switch (index) {
    case 0:
        timerTotalSeconds = timerMinutes * 60 + timerSeconds;
        timerPausedSeconds = timerTotalSeconds;
        showTimer = true;
        drawTimer();
        break;
    case 1:
        showStopwatch = true;
        drawStopwatch();
        break;
    case 2:
        showPomodoro = true;
        pomodoroPhase = POMODORO_WORK;
        pomodoroRemainingSeconds = pomodoroWorkSeconds;
        drawPomodoro();
        break;
    case 3:
        showSettings = true;
        drawSettings();
        break;
    case 4:
        showInfo = true;
        drawInfo();
        break;
    case 5:
        showBluetoothSettings = true;
        drawBluetoothSettings();
        break;
    case 6:
        showFocusModeSettings = true;
        drawFocusModeSettings();
        break;
    }
}

// ----- BLUETOOTH SECTION -----

void startBluetooth() {
    Serial.println("Starting BLE BlinkBot...");
    BLEDevice::init("BlinkBot-v1");

    BLEServer *pServer = BLEDevice::createServer();
    pServer->setCallbacks(new ServerCallbacks());

    BLEService *pService = pServer->createService(SERVICE_UUID);

    // App State Characteristic
    BLECharacteristic *pAppStateCharacteristic = pService->createCharacteristic(
        APP_STATE_CHARACTERISTIC_UUID,
        BLECharacteristic::PROPERTY_WRITE);
    pAppStateCharacteristic->setCallbacks(new AppStateCallbacks());

    // Focus Mode Characteristic
    BLECharacteristic *pFocusModeCharacteristic = pService->createCharacteristic(
        FOCUS_MODE_CHARACTERISTIC_UUID,
        BLECharacteristic::PROPERTY_WRITE);
    pFocusModeCharacteristic->setCallbacks(new FocusModeCallbacks());

    // Face Control Characteristic
    BLECharacteristic *pFaceControlCharacteristic = pService->createCharacteristic(
        FACE_CONTROL_CHARACTERISTIC_UUID,
        BLECharacteristic::PROPERTY_WRITE);
    pFaceControlCharacteristic->setCallbacks(new FaceControlCallbacks());

    // Custom Face Select Characteristic
    BLECharacteristic *pCustomFaceSelectCharacteristic = pService->createCharacteristic(
        CUSTOM_FACE_SELECT_CHARACTERISTIC_UUID,
        BLECharacteristic::PROPERTY_WRITE);
    pCustomFaceSelectCharacteristic->setCallbacks(new CustomFaceSelectCallbacks());

    // Custom Face Data Characteristic
    BLECharacteristic *pCustomFaceDataCharacteristic = pService->createCharacteristic(
        CUSTOM_FACE_DATA_CHARACTERISTIC_UUID,
        BLECharacteristic::PROPERTY_WRITE);
    pCustomFaceDataCharacteristic->setCallbacks(new CustomFaceDataCallbacks());

    pService->start();

    BLEAdvertising *pAdvertising = BLEDevice::getAdvertising();
    pAdvertising->addServiceUUID(SERVICE_UUID);
    pAdvertising->setScanResponse(true);
    pAdvertising->setMinPreferred(0x06); // Helps with iPhone connection issues
    pAdvertising->setMinPreferred(0x12);
    BLEDevice::startAdvertising();
    Serial.println("Characteristic defined! Now advertising...");
}

// ----- BUZZER SECTION -----

void buzzerStartStop(bool isStart) {
    buzzerStartTime = millis();
    buzzerActive = true;
    buzzerToneType = isStart ? 1 : 2;

    if (isStart) {
        tone(BUZZER_PIN, NOTE_C5);
    } else {
        tone(BUZZER_PIN, NOTE_A4);
    }
}

void buzzerTimerFinished() {
    buzzerStartTime = millis();
    buzzerActive = true;
    buzzerToneType = 3;
    buzzerFinishedCount = 0;
    buzzerFinishedLastChange = millis();
    tone(BUZZER_PIN, NOTE_F5);
}

void updateBuzzer() {
    if (!buzzerActive)
        return;

    unsigned long now = millis();

    if (buzzerToneType == 1 || buzzerToneType == 2) {
        if (now - buzzerStartTime >= 100) {
            noTone(BUZZER_PIN);
            buzzerActive = false;
            buzzerToneType = 0;
        }
    } else if (buzzerToneType == 3) {
        unsigned long elapsed = now - buzzerFinishedLastChange;

        if (buzzerFinishedCount < 5) {
            if (elapsed >= 150) {
                if (buzzerFinishedCount % 2 == 0) {
                    noTone(BUZZER_PIN);
                } else {
                    tone(BUZZER_PIN, NOTE_F5);
                }
                buzzerFinishedCount++;
                buzzerFinishedLastChange = now;
            }
        } else {
            if (elapsed >= 150) {
                noTone(BUZZER_PIN);
                buzzerActive = false;
                buzzerToneType = 0;
            }
        }
    }
}

// ----- MENU ITEMS SECTION -----

unsigned long getRemainingTimer() {
    if (!timerRunning)
        return timerPausedSeconds;
    unsigned long elapsed = (millis() - _timerBegin) / 1000;
    long remaining = timerTotalSeconds - elapsed;
    return (remaining > 0) ? remaining : 0;
}

unsigned long getElapsedStopwatch() {
    if (!stopwatchRunning)
        return stopwatchPausedMillis;
    return millis() - _stopwatchBegin;
}

unsigned long getRemainingPomodoro() {
    if (!pomodoroRunning)
        return pomodoroRemainingSeconds;
    unsigned long elapsed = (millis() - pomodoroStartMillis) / 1000;
    long remaining = ((pomodoroPhase == POMODORO_WORK) ? pomodoroWorkSeconds : pomodoroBreakSeconds) - elapsed;
    return (remaining > 0) ? remaining : 0;
}

void updateTimer() {
    if (showTimer && timerRunning) {
        unsigned long remaining = getRemainingTimer();
        drawTimer();

        if (remaining == 0) {
            timerRunning = false;
            timerFinished = true;
            celebrationAnimationPlaying = true;
            celebrationStartTime = millis();
            celebrationBlinkCount = 0;
            celebrationLastChange = millis();
            celebrationShowingCelebrate = true;
            buzzerTimerFinished();
            buzzerPlayedTimerFinished = true;
        }
    }

    if (showTimer && !timerRunning && !timerFinished && !showSubMenu) {
        if (millis() - lastBlinkTime > blinkInterval) {
            blinkVisible = !blinkVisible;
            lastBlinkTime = millis();
            drawTimer();
        }
    }

    if (showTimer && timerFinished && celebrationAnimationPlaying) {
        drawTimer();
    }

    if (showTimer && timerFinished && !celebrationAnimationPlaying) {
        drawTimer();
    }
}

void updateStopwatch() {
    if (showStopwatch && stopwatchRunning)
        drawStopwatch();
}

void updatePomodoro() {
    if (showPomodoro && pomodoroRunning) {
        unsigned long remaining = getRemainingPomodoro();
        drawPomodoro();

        if (remaining == 0 && !pomodoroFinished) {
            pomodoroRunning = false;
            pomodoroFinished = true;
            celebrationAnimationPlaying = true;
            celebrationStartTime = millis();
            celebrationBlinkCount = 0;
            celebrationLastChange = millis();
            celebrationShowingCelebrate = true;
            buzzerTimerFinished();
            drawPomodoro();
        }
    } else if (showPomodoro && !pomodoroRunning && !pomodoroFinished && !showSubMenu) {
        if (millis() - lastBlinkTime > blinkInterval) {
            blinkVisible = !blinkVisible;
            lastBlinkTime = millis();
            drawPomodoro();
        }
    }

    if (showPomodoro && pomodoroFinished && celebrationAnimationPlaying) {
        drawPomodoro();
    }

    if (showPomodoro && pomodoroFinished && !celebrationAnimationPlaying) {
        drawPomodoro();
    }
}

// ----- ANIMATION SECTION -----

void updateHomeAnimation() {
    if (showHome) {
        switch (currentAnimationState) {
        case ANIM_HAPPY:
            updateTemporaryEmotionAnimation();
            break;
        case ANIM_SAD:
            drawFaceFrame(currentFace->sadFrames[0]);
            break;
        case ANIM_ANGRY:
            drawFaceFrame(currentFace->angryFrames[0]);
            break;
        case ANIM_IDLE:
        default:
            updateIdleBlinkAnimation(true);
            break;
        }
        display.display();
    }
}

void resetFaceAnimation() {
    isBlinking = false;
    currentFrame = 0;
    lastAnimBlinkTime = millis();
    lastAnimUpdate = millis();
    celebrationAnimationPlaying = false;
    celebrationBlinkCount = 0;
}

void drawFaceFrame(const unsigned char *bmp) {
    display.fillRect(0, 0, SCREEN_WIDTH, SCREEN_HEIGHT, BLACK);
    display.drawBitmap(0, 0, bmp, SCREEN_WIDTH, SCREEN_HEIGHT, WHITE);
}

void updateIdleBlinkAnimation(bool active) {
    unsigned long now = millis();
    int blinkFramesLen = currentFace->blinkFrameCount;

    if (!active) {
        resetFaceAnimation();
        return;
    }

    if (!isBlinking && now - lastAnimBlinkTime >= animBlinkInterval) {
        isBlinking = true;
        currentFrame = 0;
        lastAnimBlinkTime = now;
        lastAnimUpdate = now - animDelay;
    }

    if (isBlinking) {
        if (now - lastAnimUpdate >= animDelay) {
            lastAnimUpdate = now;
            if (currentFrame < blinkFramesLen) {
                drawFaceFrame(currentFace->blinkFrames[currentFrame]);
                currentFrame++;
            }
            if (currentFrame >= blinkFramesLen) {
                isBlinking = false;
            }
        } else {
            int idx = currentFrame;
            if (idx >= blinkFramesLen)
                idx = blinkFramesLen - 1;
            if (idx < 0)
                idx = 0;
            drawFaceFrame(currentFace->blinkFrames[idx]);
        }
        return;
    }

    drawFaceFrame(currentFace->idleFrames[0]);
}

void updateTemporaryEmotionAnimation() {
    unsigned long now = millis();

    if (celebrationBlinkCount < 5) {
        unsigned long elapsed = now - celebrationLastChange;

        if (elapsed >= 250) {
            if (celebrationBlinkCount % 2 == 0) {
                celebrationShowingCelebrate = false;
            } else {
                celebrationShowingCelebrate = true;
            }
            celebrationBlinkCount++;
            celebrationLastChange = now;
        }
    } else {
        unsigned long elapsed = now - celebrationLastChange;
        if (elapsed >= 250) {
            currentAnimationState = ANIM_IDLE; // Return to idle after animation
            resetFaceAnimation();
        }
    }

    if (celebrationShowingCelebrate) {
        drawFaceFrame(currentFace->happyFrames[0]);
    } else {
        drawFaceFrame(currentFace->idleFrames[0]);
    }
}

void updateCelebrationAnimation() {
    unsigned long now = millis();

    if (celebrationBlinkCount < 5) {
        unsigned long elapsed = now - celebrationLastChange;

        if (elapsed >= 250) {
            if (celebrationBlinkCount % 2 == 0) {
                celebrationShowingCelebrate = false;
            } else {
                celebrationShowingCelebrate = true;
            }
            celebrationBlinkCount++;
            celebrationLastChange = now;
        }
    } else {
        unsigned long elapsed = now - celebrationLastChange;
        if (elapsed >= 250) {
            celebrationAnimationPlaying = false;
        }
    }

    if (celebrationShowingCelebrate) {
        drawFaceFrame(currentFace->happyFrames[0]);
    } else {
        drawFaceFrame(currentFace->idleFrames[0]);
    }
}

// ----- DISPLAY SECTION -----

void drawSubMenu(int y = 50) {
    int buttonWidth = 60;
    int buttonHeight = 14;
    for (int i = 0; i < subMenuLength; i++) {
        int x = i * buttonWidth;
        if (i == subMenuIndex) {
            display.fillRect(x, y, buttonWidth, buttonHeight, SSD1306_WHITE);
            display.setTextColor(SSD1306_BLACK);
        } else {
            display.drawRect(x, y, buttonWidth, buttonHeight, SSD1306_WHITE);
            display.setTextColor(SSD1306_WHITE);
        }
        int16_t x1, y1;
        uint16_t w, h;
        display.getTextBounds(subMenuItems[i], 0, 0, &x1, &y1, &w, &h);
        int textX = x + (buttonWidth - w) / 2;
        int textY = y + (buttonHeight - h) / 2;
        display.setCursor(textX, textY);
        display.print(subMenuItems[i]);
    }
}

void drawHome() {
    display.fillRect(0, 50, SCREEN_WIDTH, 14, BLACK);
    display.setTextSize(2);
    display.setTextColor(SSD1306_WHITE);
    display.display();
}

void drawMenu() {
    display.clearDisplay();
    display.setTextSize(1);
    display.setTextColor(SSD1306_WHITE);
    display.setCursor(0, 0);
    display.print("MENU");

    display.print(" (");
    display.print(currentPage + 1);
    display.print("/");
    display.print(totalPages);
    display.print(")");

    int startIndex = currentPage * itemsPerPage;
    int endIndex = min(startIndex + itemsPerPage, menuLength);
    int itemsToShow = min(endIndex - startIndex, itemsPerPage);

    for (int i = 0; i < itemsToShow; i++) {
        int menuIndex = startIndex + i;
        if (menuIndex >= menuLength)
            break;

        display.setCursor(5, 15 + (i * 12));

        if (menuIndex == selectedItem) {
            display.print("> ");
            display.setTextColor(SSD1306_BLACK);
            display.fillRect(15, 15 + (i * 12) - 1, 110, 10, SSD1306_WHITE);
            display.setCursor(17, 15 + (i * 12));
        } else {
            display.print("  ");
        }

        display.print(menuItems[menuIndex]);
        display.setTextColor(SSD1306_WHITE);
    }

    display.display();
}

void drawTimer() {
    display.clearDisplay();

    unsigned long remaining = getRemainingTimer();
    if (!timerRunning && !timerFinished)
        remaining = timerPausedSeconds;

    int minutes = remaining / 60;
    int seconds = remaining % 60;

    if (timerRunning) {
        updateIdleBlinkAnimation(true);

        display.setTextSize(1);
        display.setTextColor(SSD1306_WHITE);

        char timeStr[6];
        sprintf(timeStr, "%02d:%02d", minutes, seconds);

        int16_t x1, y1;
        uint16_t w, h;
        display.getTextBounds(timeStr, 0, 0, &x1, &y1, &w, &h);
        int textX = SCREEN_WIDTH - w - 2;
        int textY = SCREEN_HEIGHT - h - 2;

        display.fillRect(textX - 1, textY - 1, w + 2, h + 2, SSD1306_BLACK);
        display.drawRect(textX - 1, textY - 1, w + 2, h + 2, SSD1306_WHITE);

        display.setCursor(textX + 1, textY);
        display.print(timeStr);
    } else if (timerFinished) {
        if (celebrationAnimationPlaying) {
            updateCelebrationAnimation();
        } else {
            drawFaceFrame(currentFace->happyFrames[0]);
        }

        display.setTextSize(1);
        display.setTextColor(SSD1306_WHITE);

        int16_t x1, y1;
        uint16_t w, h;
        display.getTextBounds("DONE", 0, 0, &x1, &y1, &w, &h);
        int textX = SCREEN_WIDTH - w - 2;
        int textY = SCREEN_HEIGHT - h - 2;

        display.fillRect(textX - 1, textY - 1, w + 2, h + 2, SSD1306_BLACK);
        display.drawRect(textX - 1, textY - 1, w + 2, h + 2, SSD1306_WHITE);

        display.setCursor(textX + 1, textY);
        display.print("DONE");
    } else {
        display.setTextSize(2);
        display.setTextColor(SSD1306_WHITE);

        display.setCursor(10, 20);
        display.printf("%02d:%02d", minutes, seconds);

        if (!timerFinished && !showSubMenu && blinkVisible) {
            if (timerEditField == TIMER_EDIT_MINUTE)
                display.fillRect(10, 45, 20, 2, SSD1306_WHITE);
            else if (timerEditField == TIMER_EDIT_SECOND)
                display.fillRect(46, 45, 20, 2, SSD1306_WHITE);
        }

        display.setTextSize(1);
        display.setCursor(0, 0);
        display.print("TIMER");

        if (showSubMenu) {
            drawSubMenu(50);
        }
    }

    display.display();
}

void drawStopwatch() {
    display.clearDisplay();
    display.setTextSize(2);
    display.setTextColor(SSD1306_WHITE);

    unsigned long elapsed;
    if (stopwatchRunning)
        elapsed = millis() - _stopwatchBegin;
    else
        elapsed = stopwatchPausedMillis;

    unsigned long minutes = (elapsed / 1000) / 60;
    unsigned long seconds = (elapsed / 1000) % 60;
    unsigned long millisecs = (elapsed % 1000) / 10;

    display.setCursor(10, 20);
    display.printf("%02lu:%02lu:%02lu", minutes, seconds, millisecs);

    display.setTextSize(1);
    display.setCursor(0, 0);
    display.print("STOPWATCH");

    if (showSubMenu) {
        drawSubMenu(50);
    }

    display.display();
}

void drawPomodoro() {
    display.clearDisplay();

    unsigned long remaining = getRemainingPomodoro();
    int minutes = remaining / 60;
    int seconds = remaining % 60;

    if (pomodoroRunning) {
        updateIdleBlinkAnimation(true);

        display.setTextSize(1);
        display.setTextColor(SSD1306_WHITE);

        char timeStr[12];
        sprintf(timeStr, "%02d:%02d", minutes, seconds);

        int16_t x1, y1;
        uint16_t w, h;
        display.getTextBounds(timeStr, 0, 0, &x1, &y1, &w, &h);
        int textX = SCREEN_WIDTH - w - 2;
        int textY = SCREEN_HEIGHT - h - 2;

        display.fillRect(textX - 1, textY - 1, w + 2, h + 2, SSD1306_BLACK);
        display.drawRect(textX - 1, textY - 1, w + 2, h + 2, SSD1306_WHITE);

        display.setCursor(textX + 1, textY);
        display.print(timeStr);

        const char *phaseStateText = (pomodoroPhase == POMODORO_WORK) ? "WORK" : "BREAK";
        display.getTextBounds(phaseStateText, 0, 0, &x1, &y1, &w, &h);
        int stateX = 2;
        int stateY = SCREEN_HEIGHT - h - 2;

        display.fillRect(stateX - 1, stateY - 1, w + 2, h + 2, SSD1306_BLACK);
        display.drawRect(stateX - 1, stateY - 1, w + 2, h + 2, SSD1306_WHITE);

        display.setCursor(stateX + 1, stateY);
        display.print(phaseStateText);
    } else if (pomodoroFinished) {
        if (celebrationAnimationPlaying) {
            updateCelebrationAnimation();
        } else {
            drawFaceFrame(currentFace->happyFrames[0]);
        }

        display.setTextSize(1);
        display.setTextColor(SSD1306_WHITE);

        const char *phaseText = "DONE";

        int16_t x1, y1;
        uint16_t w, h;
        display.getTextBounds(phaseText, 0, 0, &x1, &y1, &w, &h);
        int textX = SCREEN_WIDTH - w - 2;
        int textY = SCREEN_HEIGHT - h - 2;

        display.fillRect(textX - 1, textY - 1, w + 2, h + 2, SSD1306_BLACK);
        display.drawRect(textX - 1, textY - 1, w + 2, h + 2, SSD1306_WHITE);

        display.setCursor(textX + 1, textY);
        display.print(phaseText);

        const char *phaseStateText = (pomodoroPhase == POMODORO_WORK) ? "WORK" : "BREAK";
        display.getTextBounds(phaseStateText, 0, 0, &x1, &y1, &w, &h);
        int stateX = 2;
        int stateY = SCREEN_HEIGHT - h - 2;

        display.fillRect(stateX - 1, stateY - 1, w + 2, h + 2, SSD1306_BLACK);
        display.drawRect(stateX - 1, stateY - 1, w + 2, h + 2, SSD1306_WHITE);

        display.setCursor(stateX + 1, stateY);
        display.print(phaseStateText);
    } else {
        display.setTextSize(2);
        display.setTextColor(SSD1306_WHITE);

        display.setCursor(10, 20);
        display.printf("%02d:%02d", minutes, seconds);

        if (!pomodoroFinished && !showSubMenu && blinkVisible) {
            if (pomodoroEditField == POMODORO_EDIT_MINUTE)
                display.fillRect(10, 45, 20, 2, SSD1306_WHITE);
            else if (pomodoroEditField == POMODORO_EDIT_SECOND)
                display.fillRect(46, 45, 20, 2, SSD1306_WHITE);
        }

        display.setTextSize(1);
        display.setCursor(0, 0);
        if (pomodoroPhase == POMODORO_WORK)
            display.print("POMODORO - WORK");
        else
            display.print("POMODORO - BREAK");

        if (showSubMenu) {
            drawSubMenu(50);
        }
    }

    display.display();
}

void drawSettings() {
    display.clearDisplay();
    display.setTextSize(1);
    display.setTextColor(SSD1306_WHITE);

    display.setCursor(0, 0);
    display.println("SETTINGS");

    for (int i = 0; i < settingsMenuLength; i++) {
        display.setCursor(5, 15 + (i * 12));

        if (i == settingsSelectedItem) {
            display.print("> ");
            display.setTextColor(SSD1306_BLACK);
            display.fillRect(15, 15 + (i * 12) - 1, 110, 10, SSD1306_WHITE);
            display.setCursor(17, 15 + (i * 12));
        } else {
            display.print("  ");
        }

        display.print(settingsMenuItems[i]);
        display.print(": ");

        if (i == 0) { // Style
            if (currentStyle == 0) {
                display.print("Default");
            } else {
                display.print("Custom");
                if (!customFaceAvailable) {
                    display.print(" (NA)");
                }
            }
        } else if (i == 1) {
            display.print("ON"); // Placeholder
        } else if (i == 2) {
            display.print("BRIGHT"); // Placeholder
        }

        display.setTextColor(SSD1306_WHITE);
    }

    display.display();
}

void drawInfo() {
    display.clearDisplay();
    display.setTextSize(1);
    display.setTextColor(SSD1306_WHITE);
    display.setCursor(0, 0);
    display.println("INFO");
    display.setCursor(10, 15);
    display.println("Blink Bot v1.0");
    display.setCursor(10, 25);
    display.println("Your productivity");
    display.setCursor(10, 35);
    display.println("friend XD");
    display.display();
}
